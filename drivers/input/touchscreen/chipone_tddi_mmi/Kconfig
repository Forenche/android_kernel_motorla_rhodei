## drivers/input/touchscreen/chipone_tddi_mmi/Kconfig
```kconfig
config TOUCHSCREEN_CHIPONE_TDDI
	tristate "Chipone TDDI"
	default n
	help
	Say Y if you want to build the driver inline or m if you want to build it as a module.

config CONFIG_CHIPONE_ESD
	bool "Enable ESD checks for Chipone TDDI"
	depends on TOUCHSCREEN_CHIPONE_TDDI
	default n
	
```

## drivers/power/Kconfig
```kconfig
# SPDX-License-Identifier: GPL-2.0-only
source "drivers/power/avs/Kconfig"
source "drivers/power/reset/Kconfig"
source "drivers/power/supply/Kconfig"

source "drivers/power/bq2589x_chg_mmi/Kconfig"
source "drivers/power/sgm4154x_chg_mmi/Kconfig"
```

## drivers/power/sgm4154x_chg_mmi/Kconfig
```kconfig
config SGM4154X_CHARGER_MMI
	tristate "SGM4154x Charger"
	default n

config MMI_QC3P_WT6670_DETECTED
	bool "30W quickcharge plus detection"
	depends on SGM4154X_CHARGER_MMI
	default n
```
